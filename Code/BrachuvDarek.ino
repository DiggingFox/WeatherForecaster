#include <U8g2lib.h>
#include <ESP8266WiFi.h>
#include <ESP8266HTTPClient.h>
#include <WiFiClientSecure.h>
#include <ArduinoJson.h>
#include <WiFiManager.h>          //https://github.com/tzapu/WiFiManager WiFi Configuration Magic

// D0 - CLK
// D1 - MOSI
U8G2_SSD1306_128X64_NONAME_F_4W_SW_SPI u8g2(U8G2_R0, /* clock=*/ 4, /* data=*/ 2, /* cs=*/ 5, /* dc=*/ 13, /* reset=*/ 12);
//U8G2_SSD1306_128X64_NONAME_F_4W_SW_SPI u8g2(U8G2_R0, /* clock=*/ D4, /* data=*/ D5, /* cs=*/ D8, /* dc=*/ D7, /* reset=*/ D6);0

const char* host = "api.openweathermap.org";
const int httpsPort = 443;
const char* url = "/data/2.5/forecast"; //Predpoved
//const char* url = "/data/2.5/weather";  //Aktualni
const char* openweathermapid = "3070544"; //Mlada Boleslav
const char* openweathermapq = "Mladá%20Boleslav"; //Mlada Boleslav
const char* openweathermapunits = "metric"; //Celsia
//const char* APPID    = "81d90d07a5eb5eddf921c617a5a3f8ee";
const char* APPID    = "ebe4b9c97b34c7c1c0270723ebb3fae7";

const char *ssid = "WeatherForecast";

  // Use WiFiClientSecure class to create TLS connection
  WiFiClientSecure client;
os_timer_t clockTimer;
os_timer_t refreshTimer;

char OLEDBuffer[64];

int refresh = 0;
  
uint8_t icon01[5*40] =
{
  0x00, 0x00, 0x18, 0x00, 0x00, 
  0x00, 0x00, 0x18, 0x00, 0x00, 
  0x00, 0x00, 0x18, 0x00, 0x00, 
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  0x00, 0x00, 0x18, 0x00, 0x00, 
};

uint8_t icon02[5*40] =
{
  0x00, 0x00, 0x00, 0x00, 0x00, 
  0x00, 0x00, 0x00, 0x00, 0x00, 
  0x00, 0x00, 0x00, 0x00, 0x00, 
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  0x00, 0x00, 0x00, 0x00, 0x00, 
};
  
uint8_t icon03[5*40] =
{
  0x00, 0x00, 0x00, 0x00, 0x00, 
  0x00, 0x00, 0x00, 0x00, 0x00, 
  0x00, 0x00, 0xf0, 0x00, 0x00, 
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  0x00, 0x00, 0x00, 0x00, 0x00, 
};
uint8_t icon04[5*40] =
{
  0x00, 0x00, 0x00, 0x00, 0x00, 
  0x00, 0x00, 0x00, 0x00, 0x00, 
  0x00, 0x00, 0xf0, 0x00, 0x00, 
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  0x00, 0x00, 0x00, 0x00, 0x00, 
};
  
uint8_t icon09[5*40] =
{
  0x00, 0x07, 0xff, 0x00, 0x00, 
  0x00, 0x0f, 0xff, 0xc0, 0x00, 
  0x00, 0x1f, 0xff, 0xe0, 0x00, 
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  0x00, 0x30, 0x00, 0x40, 0x00, 
};
  
uint8_t icon10[5*40] =
{
  0x00, 0x07, 0xff, 0x00, 0x00, 
  0x00, 0x0f, 0xff, 0xc0, 0x00, 
  0x00, 0x1f, 0xff, 0xe0, 0x00, 
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  0x00, 0x30, 0x00, 0x40, 0x00, 
};
  
uint8_t icon11[5*40] =
{
  0x00, 0x01, 0xfe, 0x00, 0x00, 
  0x00, 0x07, 0xff, 0x00, 0x00, 
  0x00, 0x1f, 0xff, 0xc0, 0x00, 
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  0x00, 0x00, 0x40, 0x00, 0x00, 
};
  
uint8_t icon13[5*40] =
{
  0x00, 0x00, 0x00, 0x00, 0x00, 
  0x00, 0x00, 0xfc, 0x00, 0x00, 
  0x00, 0x03, 0xff, 0x00, 0x00, 
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  0x0c, 0x00, 0x00, 0x00, 0x00, 
};

uint8_t icon50[5*40] =
{
  0x00, 0x00, 0x00, 0x00, 0x00, 
  0x00, 0x00, 0x00, 0x00, 0x00, 
  0x00, 0x00, 0x00, 0x00, 0x00, 
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  0x00, 0x00, 0x00, 0x00, 0x00, 
};

struct Weather
{
  ////String description;
  String icon;
} weather;

struct Wind
{
  float speedd;
  ////int deg;
} wind;

struct openWeatherMap 
{
  float temperature;
  ////float pressure;
  ////float humidity;
  float clouds;
  Wind wind;
  float rain;
  long date;
  String dt_txt;
  Weather weather;  //stringy nakonec
} openweathermap;
/*
struct Wind
{
  String speedd;
  String deg;
} wind;

struct openWeatherMap 
{
  String temperature;
  String pressure;
  String humidity;
  String clouds;
  Wind wind;
  String rain;
  String date;
  String dt_txt;
  Weather weather;  //stringy nakonec
} openweathermap;*/

  int attempt = 0;
  int refreshDisplay = 0;
openWeatherMap weatherForecast[60];
unsigned int dataCnt = 0;
unsigned int dayCnt = 0;

unsigned int displayCnt = 0;

String date;
String stringsToFind[11] = {"\"temp\"", "\"pressure\"", "\"humidity\"", "\"description\"", "\"icon\"", "\"clouds\":{\"all\"", "\"speed\"", "\"deg\"", "\"rain\":{\"3h\"", "\"dt\"", "\"dt_txt\""};

//String param = String(url) +
//               "?id=" + openweathermapid +
//               "&units=" + openweathermapunits +
//               "&APPID=" + APPID;

//https://api.openweathermap.org/data/2.5/forecast?q=Mlad%C3%A1%20Boleslav&units=metric&appid=16dcb820421e6085b87df837836679b2
String param = String(url) +
               "?q=" + openweathermapq +
               "&units=" + openweathermapunits +
               "&appid=" + APPID +
               "&mode=json";


void refreshCallback(void *pArg)
{
  refresh = 1;
  
}

void showIcon(int Icon, unsigned int x, unsigned int y)
{
  
  switch(Icon)
  {
    case 1: //ikona
      u8g2.drawBitmap(x, y, 5, 40, icon01);
      break;
    case 2: //ikona
      u8g2.drawBitmap(x, y, 5, 40, icon02);
      break;
    case 3: //ikona
      u8g2.drawBitmap(x, y, 5, 40, icon03);
      break;
    case 4: //ikona
      u8g2.drawBitmap(x, y, 5, 40, icon04);
      break;
    case 9: //ikona
      u8g2.drawBitmap(x, y, 5, 40, icon09);
      break;
    case 10: //ikona
      u8g2.drawBitmap(x, y, 5, 40, icon10);
      break;
    case 11: //ikona
      u8g2.drawBitmap(x, y, 5, 40, icon11);
      break;
    case 13: //ikona
      u8g2.drawBitmap(x, y, 5, 40, icon13);
      break;
    case 50: //ikona
      u8g2.drawBitmap(x, y, 5, 40, icon50);
      break;
    default:
      break;
  }
}

void clockCallback(void *pArg)
{
  int pointer0 = (3*(displayCnt/5));
  int pointer1 = (3*(displayCnt/5))+1;
  int pointer2 = (3*(displayCnt/5))+2;
  
  u8g2.setFont(u8g2_font_pxplusibmcga_8f); 
  u8g2.clearBuffer();
  weatherForecast[pointer0].dt_txt.toCharArray(OLEDBuffer, 6);
  u8g2.drawStr(0, 64, OLEDBuffer);
  if(pointer1 < 12)
  {
    weatherForecast[pointer1].dt_txt.toCharArray(OLEDBuffer, 6);
    u8g2.drawStr(44, 64, OLEDBuffer);
  }
  if(pointer2 < 12)
  {
    weatherForecast[pointer2].dt_txt.toCharArray(OLEDBuffer, 6);
    u8g2.drawStr(88, 64, OLEDBuffer);
  }
  //displayCnt/5

//  
//struct openWeatherMap 
//{
//  float temperature;
//  ////float pressure;
//  ////float humidity;
//  float clouds;
//  Wind wind;
//  float rain;
//  long date;
//  String dt_txt;
//  Weather weather;  //stringy nakonec
//} openweathermap;
      char postfix[4];
      int x0=0;
      int x1=42;
      int x2=84;

  u8g2.setFont(u8g2_font_pxplusibmvga8_tf); 
  switch(displayCnt%5)
  {
    case 0: //ikona
      showIcon(weatherForecast[pointer0].weather.icon.toInt(), 1,5);
      if(pointer1 < 12)
      {
        showIcon(weatherForecast[pointer1].weather.icon.toInt(), 43,5);
      }
      if(pointer2 < 12)
      {
        showIcon(weatherForecast[pointer2].weather.icon.toInt(), 86,5);
      }
      break;
    case 1: //teplota
    
//      if(weatherForecast[pointer0].temperature <= -10.0) x0 = 20-5*4;
//      else if(weatherForecast[pointer0].temperature < 0.0) x0 = 20-4*4;
//      else if(weatherForecast[pointer0].temperature == 0.0) x0 = 20-3*4;
//      else if(weatherForecast[pointer0].temperature > 0.0) x0 = 20-3*4;
//      else if(weatherForecast[pointer0].temperature > 10.0) x0 = 20-4*4;
//      
//      if(weatherForecast[pointer1].temperature <= -10.0) x1 = 64-5*4;
//      else if(weatherForecast[pointer1].temperature < 0.0) x1 = 64-4*4;
//      else if(weatherForecast[pointer1].temperature == 0.0) x1 = 64-3*4;
//      else if(weatherForecast[pointer1].temperature > 0.0) x1 = 42;
//      else if(weatherForecast[pointer1].temperature > 10.0) x1 = 64-4*4;
//      
//      if(weatherForecast[pointer2].temperature <= -10.0) x2 = 108-5*4;
//      else if(weatherForecast[pointer2].temperature < 0.0) x2 = 108-4*4;
//      else if(weatherForecast[pointer2].temperature == 0.0) x2 = 108-3*4;
//      else if(weatherForecast[pointer2].temperature > 0.0) x2 = 108-3*4;
//      else if(weatherForecast[pointer2].temperature > 10.0) x2 = 108-4*4;
      sprintf(OLEDBuffer, "%4.1f", weatherForecast[pointer0].temperature);
      u8g2.drawStr(x0, 25, OLEDBuffer);
        sprintf(postfix, "  ");
      postfix[0] = '°';
      postfix[1] = 'C';
      u8g2.drawStr(8, 40, postfix);
      if(pointer1 < 12)
      {
        sprintf(OLEDBuffer, "%4.1f", weatherForecast[pointer1].temperature);
        u8g2.drawStr(x1, 25, OLEDBuffer);
        u8g2.drawStr(52, 40, postfix);
      }
      if(pointer2 < 12)
      {
        sprintf(OLEDBuffer, "%4.1f", weatherForecast[pointer2].temperature);
        u8g2.drawStr(x2, 25, OLEDBuffer);
        u8g2.drawStr(96, 40, postfix);
      }
      break;
    case 2: //dest
      sprintf(OLEDBuffer, "%4.1f", weatherForecast[pointer0].rain);
      u8g2.drawStr(x0, 25, OLEDBuffer);
      sprintf(postfix, "mm");
      u8g2.drawStr(12, 40, postfix);
      if(pointer1 < 12)
      {
        sprintf(OLEDBuffer, "%4.1f", weatherForecast[pointer1].rain);
        u8g2.drawStr(x1, 25, OLEDBuffer);
        u8g2.drawStr(56, 40, postfix);
      }
      if(pointer2 < 12)
      {
        sprintf(OLEDBuffer, "%4.1f", weatherForecast[pointer2].rain);
        u8g2.drawStr(x2, 25, OLEDBuffer);
        u8g2.drawStr(100, 40, postfix);
      }
      break;
    case 3: //mraky
      sprintf(OLEDBuffer, "%4.0f", weatherForecast[pointer0].clouds);
      u8g2.drawStr(x0, 25, OLEDBuffer);
      sprintf(postfix, " ");
      postfix[0] = '%';
      u8g2.drawStr(16, 40, postfix);
      if(pointer1 < 12)
      {
        sprintf(OLEDBuffer, "%4.0f", weatherForecast[pointer1].clouds);
        u8g2.drawStr(x1, 25, OLEDBuffer);
        u8g2.drawStr(60, 40, postfix);
      }
      if(pointer2 < 12)
      {
        sprintf(OLEDBuffer, "%4.0f", weatherForecast[pointer2].clouds);
        u8g2.drawStr(x2, 25, OLEDBuffer);
        u8g2.drawStr(104, 40, postfix);
      }
      break;
    case 4: //vitr
      sprintf(OLEDBuffer, "%4.1f", weatherForecast[pointer0].wind.speedd);
      u8g2.drawStr(x0, 25, OLEDBuffer);
      sprintf(postfix, "m/s");
      u8g2.drawStr(8, 40, postfix);
      if(pointer1 < 12)
      {
        sprintf(OLEDBuffer, "%4.1f", weatherForecast[pointer1].wind.speedd);
        u8g2.drawStr(x1, 25, OLEDBuffer);
        u8g2.drawStr(52, 40, postfix);
      }
      if(pointer2 < 12)
      {
        sprintf(OLEDBuffer, "%4.1f", weatherForecast[pointer2].wind.speedd);
        u8g2.drawStr(x2, 25, OLEDBuffer);
        u8g2.drawStr(96, 40, postfix);
      }
      break;
  }
  
  //u8g2.drawBitmap(0, 4, 5, 40, icon01);

  
  refreshDisplay = 1;
  
  displayCnt++;
  if(displayCnt >= 20) displayCnt = 0;
}

String httpGETRequest(const char* serverName) {
  WiFiClient client;
  HTTPClient http;
    
  // Your IP address with path or Domain name with URL path 
  http.begin(client, serverName);
  
  // Send HTTP POST request
  int httpResponseCode = http.GET();
  
  String payload = "{}"; 
  
  if (httpResponseCode>0) {
    Serial.print("HTTP Response code: ");
    Serial.println(httpResponseCode);
    payload = http.getString();
  }
  else {
    Serial.print("Error code: ");
    Serial.println(httpResponseCode);
  }
  // Free resources
  http.end();

  return payload;
}

void refreshWeather()
{
  refresh = 0;
  String serverPath = "http://api.openweathermap.org/data/2.5/forecast?q=Mlad%C3%A1%20Boleslav&units=metric&appid=16dcb820421e6085b87df837836679b2";
  //String serverPath = "http://api.openweathermap.org/data/2.5/weather?q=" + city + "," + countryCode + "&APPID=" + openWeatherMapApiKey;
  String jsonBuffer = httpGETRequest(serverPath.c_str());
  Serial.println(jsonBuffer);

/*
  Serial.print("connecting to ");
  Serial.println(host);
  if (!client.connect(host, httpsPort)) {
    Serial.println("connection failed");
    return;
  }

  Serial.print("requesting URL: ");
  Serial.println(param);

  client.print(String("GET ") + param + " HTTP/1.1\r\n" +
               "Host: " + host + "\r\n" +
               "User-Agent: ESP8266\r\n" +
               "Connection: close\r\n\r\n");
               
  Serial.println("request sent");
  */
  int prevIdx = 0;
  int idx = jsonBuffer.indexOf('[', 0);
  String line = jsonBuffer.substring(0, idx);
  prevIdx = idx;
  
  Serial.println(line);
  

  //line = client.readStringUntil('\n');
  //Serial.println(line);
  /*int i = 0;
  for(; (i < 5) && (line != "HTTP/1.1 200 OK\r"); i++) {
    Serial.print("Unexpected response: ");
    //line = client.readStringUntil('\n');
    //Serial.println(line);
  }
  if(i == 5) return;
  Serial.println(line);*/
  jsonBuffer.remove(0, idx);

  Serial.println("start");

  ////line = client.readStringUntil('{');
  //date = line.substring(line.indexOf("Date: ") + 6, line.indexOf(" GMT"));
  //Serial.println(date);
  
  line = "";
  //Serial.println(line);

  
  dataCnt = 0;
  for(;; dataCnt++)
  {
    yield();
    Serial.println(dataCnt);
    ///line += client.readStringUntil('x') + 'x';
    ///line += client.readStringUntil('x') + 'x';
    ///line += client.readStringUntil('{') + '{';
    //Serial.println(line);
    idx = jsonBuffer.indexOf("},\"dt_tx", 0)+34;
    line = jsonBuffer.substring(0, idx);
    Serial.println(line);
    //int a = line.indexOf("},\"dt_tx");
    //int a = line.indexOf(']');
    if(line.indexOf("\"city\"") > 0)
    {
      Serial.println("break");
      break;
    }
    /*if(line.indexOf("}],\"city\"") > 0)
    {
      weatherForecast[dataCnt] = processForecast(line);
      break;
    }
    weatherForecast[dataCnt] = processForecast(line);*/
    weatherForecast[dataCnt] = processForecast(line);
    jsonBuffer.remove(0, idx);
    //delay(1);
    prevIdx = idx;
  }
  //client.readStringUntil('\n');
  //client.stop();
  Serial.println("done");

  sortForecast();
  
  refresh = 0;
}

void sortForecast()
{
  for(int i = 0; i < 8; i++)
  {
    //int hour = ((weatherForecast[i].date%86400)/3600);  //tady jen hodina
    weatherForecast[i].dt_txt = weatherForecast[i].dt_txt.substring(12, 17);
    //Serial.println(hour);
/*
    if(date > 12)
    {
      date -= 12;
      //weatherForecast[i].dt_txt = String::String(date, DEC) + " pm";
    }
    else if(date > 12)
    {
      //weatherForecast[i].dt_txt = String::String(date, DEC) + " pm";
    }
    else if(date = 0)
    {
      date = 12;
      //weatherForecast[i].dt_txt = String::String(date, DEC) + " am";
    }
    else
    {
      //weatherForecast[i].dt_txt = String::String(date, DEC) + " am";
    }*/
  }
  int j = 8;
  int i = 8;
  for(; i < 12; i++)
  {
    
    int hour = ((weatherForecast[i].date%86400)/3600);  //tady jen hodina
    Serial.println(hour);
    for(;j < dataCnt; j++)
    {
      if((((weatherForecast[j].date)%86400)/3600) == 12) //hledame v poledne
      {
        weatherForecast[i] = weatherForecast[j];
        String day = weatherForecast[i].dt_txt.substring(9, 11);
        String month = weatherForecast[i].dt_txt.substring(6, 8);
        weatherForecast[i].dt_txt = day + '/' + month;
        j++;
        break;
        //weatherForecast[i] = ((weatherForecast[j].date%86400)/3600);  //tady den v roce
      }
    }
    if(j == dataCnt) break;
  }
  dayCnt = i-8;


  for(int i = 0; i < 12; i++)
  {
    Serial.println(i);
    Serial.printf("Date: %d\nTemp: %4.2f\nClouds: %4.2f\nSpeed: %4.2f\nRain: %4.2f", 
          weatherForecast[i].date, 
          weatherForecast[i].temperature, 
          weatherForecast[i].clouds, 
          weatherForecast[i].wind.speedd, 
          weatherForecast[i].rain);
    Serial.println("\nIcon: " + 
          weatherForecast[i].weather.icon + "\nDate: " + 
          weatherForecast[i].dt_txt);
  }
          
}
  

String findAndParse(String oneLine, String toFind)
{
  int i = 0;
  int cntOut = 50;
  int idxStart = 0, idxStop = 0;
  int idx = oneLine.indexOf(toFind);
  if (idx == -1) return "0";
  idx += toFind.length();
  for(; i < cntOut; i++)
  {
    if((oneLine.charAt(idx+i) == ':' ) && (idxStart == 0)) idxStart = i+1;
    if((oneLine.charAt(idx+i) == ',') || (oneLine.charAt(idx+i) == '}')) break;
  }
  if(i == cntOut) return "0";
  idxStop = i;
  return oneLine.substring(idx+idxStart, idx+idxStop);
}

openWeatherMap processForecast(String oneLine)
{
  openWeatherMap tempWeather;
//String stringsToFind[11] = {"\"temp\"", "\"pressure\"", "\"humidity\"", "\"description\"", "\"icon\"", "\"clouds\":{\"all\"", "\"speed\"", "\"deg\"", "\"rain\":{\"3h\"", "\"dt\"", "\"dt_txt\""};

  tempWeather.temperature = findAndParse(oneLine, stringsToFind[0]).toFloat();
  //tempWeather.temperature = tempWeather.temperature.substring(0, tempWeather.temperature.length()-1);
  ////tempWeather.pressure = findAndParse(oneLine, stringsToFind[1]).toFloat();
  ////tempWeather.humidity = findAndParse(oneLine, stringsToFind[2]).toFloat();
  tempWeather.clouds = findAndParse(oneLine, stringsToFind[5]).toFloat();
  tempWeather.wind.speedd = findAndParse(oneLine, stringsToFind[6]).toFloat();
  ////tempWeather.wind.deg = findAndParse(oneLine, stringsToFind[7]).toFloat();
  tempWeather.rain = findAndParse(oneLine, stringsToFind[8]).toFloat();
  tempWeather.date = findAndParse(oneLine, stringsToFind[9]).toInt();
  tempWeather.dt_txt = findAndParse(oneLine, stringsToFind[10]);
  ////tempWeather.weather.description = findAndParse(oneLine, stringsToFind[3]);
  tempWeather.weather.icon = findAndParse(oneLine, stringsToFind[4]);
  //tempWeather.date.remove(tempWeather.date.indexOf('\"'), 1);
  //tempWeather.date.remove(tempWeather.date.indexOf('\"'), 1);
  ////tempWeather.weather.description.remove(tempWeather.weather.description.indexOf('\"'), 1);
  ////tempWeather.weather.description.remove(tempWeather.weather.description.indexOf('\"'), 1);
  tempWeather.weather.icon.remove(tempWeather.weather.icon.indexOf('\"'), 1);
  //tempWeather.weather.icon.remove(tempWeather.weather.icon.indexOf('\"'), 1);
  //tempWeather.weather.icon.remove(tempWeather.weather.icon.indexOf('}'), 1);
  tempWeather.weather.icon.remove(2, 3);
  
  //Serial.println();
  //Serial.println();
  //Serial.printf("Date: %d\nTemp: %4.2f\nPres:%4.2f\nHum: %4.2f\nClouds: %4.2f\nSpeed: %4.2f\nDeg: %4.2f\nrain: %4.2f\n", tempWeather.date, tempWeather.temperature, tempWeather.pressure, tempWeather.humidity, tempWeather.clouds, tempWeather.wind.speedd, tempWeather.wind.deg, tempWeather.rain);
  //Serial.println("Desc: " + tempWeather.weather.description + "\nIcon: " + tempWeather.weather.icon + "\nDate: " + tempWeather.dt_txt);
  //Serial.println("Temp: " + tempWeather.temperature + "\nClouds: " + tempWeather.temperature + "\nWind: " + tempWeather.wind.speedd);
  //Serial.println("Temp: " + tempWeather.temperature + "\nClouds: " + tempWeather.clouds + "\nIcon: " + tempWeather.icon);
  Serial.printf("Date: %d\nTemp: %4.2f\nClouds: %4.2f\nSpeed: %4.2f\nRain: %4.2f", 
          tempWeather.date, 
          tempWeather.temperature, 
          tempWeather.clouds, 
          tempWeather.wind.speedd, 
          tempWeather.rain);
  Serial.println("\nIcon: " + 
          tempWeather.weather.icon + "\nIcon: " + 
          tempWeather.dt_txt);
  delay(1);
  return tempWeather;
}


void setup() {
  Serial.begin(74880);
  
  u8g2.begin();
  u8g2.clearBuffer();
  //u8g2.setFont(u8g2_font_ncenB10_tr);
  u8g2.setFont(u8g2_font_pxplusibmvga8_tf); 
  //sprintf(OLEDBuffer, "Connecting");
  sprintf(OLEDBuffer, "Predpoved");
  u8g2.drawStr(28, 18, OLEDBuffer);
  sprintf(OLEDBuffer, "pocasi");
  u8g2.drawStr(40, 30, OLEDBuffer);
  sprintf(OLEDBuffer, "Ondrej Fidra");
  u8g2.drawStr(16, 58, OLEDBuffer);
  //u8g2.drawBitmap(0, 4, 5, 40, icon01);
  u8g2.sendBuffer();
  while(1);
  
  Serial.println();
  Serial.print("connecting to ");
  Serial.println(ssid);

  
  WiFiManager wifiManager;
  wifiManager.setTimeout(180);
  wifiManager.autoConnect(ssid);
  
  //WiFi.mode(WIFI_STA);
  //WiFi.begin(ssid, password);
  Serial.println("");
  Serial.println("WiFi connected");
  Serial.println("IP address: ");
  Serial.println(WiFi.localIP());
  u8g2.clearBuffer();
  sprintf(OLEDBuffer, "Connected");
  u8g2.drawStr(28, 38, OLEDBuffer);
  u8g2.sendBuffer();

  //clockCallback(0);
  refresh = 1;
  os_timer_setfn(&clockTimer, clockCallback, NULL);
  os_timer_arm(&clockTimer, 3000, true); //2s
  os_timer_setfn(&refreshTimer, refreshCallback, NULL);
  //os_timer_arm(&refreshTimer, 3600000, true); //1 hodina
  os_timer_arm(&refreshTimer, 3600000, true); //10 minut
  delay(100);
}

void loop() {
  if(refresh == 1)
  {
    attempt++;
    u8g2.clearBuffer();
    sprintf(OLEDBuffer, "Fetching Data");
    u8g2.drawStr(12, 38, OLEDBuffer);
    sprintf(OLEDBuffer, "attempt %d", attempt);
    u8g2.drawStr(28, 54, OLEDBuffer);
    u8g2.sendBuffer();
    refreshWeather();
    if(refresh == 0)
    {
      u8g2.clearBuffer();
      sprintf(OLEDBuffer, "Fetching OK");
      u8g2.drawStr(20, 38, OLEDBuffer);
      u8g2.sendBuffer();
    }
    else if(attempt > 5)
    {
      attempt = 0;
      refresh = 0; 
      u8g2.clearBuffer();
      sprintf(OLEDBuffer, "Fetching Error");
      u8g2.drawStr(8, 38, OLEDBuffer);
      u8g2.sendBuffer();
    }
  }
  if(refreshDisplay == 1)
  {
    refreshDisplay = 0;
      u8g2.sendBuffer();
  }
  delay(1);
  
}
